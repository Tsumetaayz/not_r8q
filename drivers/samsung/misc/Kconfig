## drivers/samsung/misc/Kconfig
```kconfig
menuconfig SEC_MISC
	bool "Enable SEC miscellaneous feature"
	default n

menu "Samsung Vbus Notifier drivers"
config VBUS_NOTIFIER
	bool "VBUS notifier support"
	default n
	help
	  If you say yes here you will get support for
	  the VBUS status change notification.
	  
config VBUS_NOTIFIER_MODULE
	tristate "VBUS notifier support module"
	default n
	help
	 this feature is for module build
	 If this feature is "m", KO object will be make
	 need modprobe for loading
	 It is made by samsung
endmenu
```
